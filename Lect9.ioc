# file: Lect9.ioc
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Mcu.Family=STM32F1
Mcu.Name=STM32F103C(8-B)Tx
Mcu.Package=LQFP48
NVIC.PriorityGroup=NVIC_PRIORITYGROUP_4
PA13.Mode=Serial_Wire
PA13.Signal=SYS_JTMS-SWDIO
PA14.Mode=Serial_Wire
PA14.Signal=SYS_JTCK-SWCLK
PD0-OSC_IN.Mode=HSE-External-Oscillator
PD0-OSC_IN.Signal=RCC_OSC_IN
PD1-OSC_OUT.Mode=HSE-External-Oscillator
PD1-OSC_OUT.Signal=RCC_OSC_OUT
ProjectManager.HeapSize=0x200
ProjectManager.StackSize=0x400
ProjectManager.TargetToolchain=STM32CubeIDE
RCC.AHBFreq_Value=72000000
RCC.APB1CLKDivider=RCC_HCLK_DIV2
RCC.APB1Freq_Value=36000000
RCC.APB1TimFreq_Value=72000000
RCC.APB2Freq_Value=72000000
RCC.APB2TimFreq_Value=72000000
RCC.HCLKFreq_Value=72000000
RCC.PLLMUL=RCC_PLL_MUL9
RCC.PLLSourceVirtual=RCC_PLLSOURCE_HSE
RCC.SYSCLKFreq_VALUE=72000000
RCC.SYSCLKSource=RCC_SYSCLKSOURCE_PLLCLK
RCC.USBFreq_Value=72000000
board=custom

// file: Core/Src/main.c
/* USER CODE BEGIN Header */
/**
 ******************************************************************************
 * @file           : main.c
 * @brief          : Main program body
 ******************************************************************************
 * @attention
 *
 * Copyright (c) 2024 STMicroelectronics.
 * All rights reserved.
 *
 * This software is licensed under terms that can be found in the LICENSE file
 * in the root directory of this software component.
 * If no LICENSE file comes with this software, it is provided AS-IS.
 *
 ******************************************************************************
 */
/* USER CODE END Header */
#include "main.h"

void SystemClock_Config(void);
static void MX_GPIO_Init(void);

int main(void) {

	/* MCU Configuration--------------------------------------------------------*/

	/* Reset of all peripherals, Initializes the Flash interface and the Systick. */
	HAL_Init();

	/* Configure the system clock */
	SystemClock_Config();

	/* USER CODE BEGIN SysInit */

	//y exists at 0x20000000
	GPIO_Struct *x;

	int y = 10;

	x = (int*) (0x20000000);

	x = (GPIO_Struct*) (0x20000000);

	/* USER CODE END SysInit */

	/* Initialize all configured peripherals */
	MX_GPIO_Init();
	/* USER CODE BEGIN 2 */

	//to use any peripheral in the chip, you first need to enable its clock input
	//this is done by using a predefined macro:
	// __HAL_RCC_nameofperipheral_CLK_ENABLE();
	__HAL_RCC_GPIOC_CLK_ENABLE();

	__HAL_RCC_GPIOA_CLK_ENABLE();

	/*
	 * using the GPIO driver we created:
	 * 1- Declare a config struct with the required configuration,
	 * 	in our case, we need to configure GPIOC Pin13 to be a output pin (push pull)
	 * 	for driving LEDs, low speed is fine
	 * */

	//1st method (Initialize the structure in definition)
	GPIO_Config_t MyConfig = { .Mode = GPIO_Out_PP, .Speed = GPIO_Speed_Low,
			.pin = GPIO_P13 };

	/*
	 * 2- Pass a pointer of the config struct to the the GPIO_Init function
	 *  along with the name of the GPIO we need to configure
	 * */
	GPIO_Init(GPIO_PortC, &MyConfig);

	//init PA0 as input pulled down
	MyConfig.Mode = GPIO_Input_Pulldown;
	MyConfig.pin = GPIO_P0;
	GPIO_Init(GPIO_PortA, &MyConfig);

	/*
	 * 3- to set the logic level of an output pin, we use the
	 *  GPIO_Set_Pin() function, passing the GPIO name and the pin(s)
	 * */

	GPIO_Set_Pin(GPIO_PortC, GPIO_P13, 1);

	/* USER CODE END 2 */

	/* Infinite loop */
	/* USER CODE BEGIN WHILE */

	/* the below code blinks the LED connected to pin C13 forever */
	while (1) {
		/* USER CODE END WHILE */

		/* USER CODE BEGIN 3 */

		//read the status of GPIOA pin0 into the variable Status
		uint8_t Status = GPIO_Get_Pin(GPIO_PortA, GPIO_P0);

		//Status 1 --> C13 0
		//Status 0 --> C13 1

		GPIO_Set_Pin(GPIO_PortC, GPIO_P13, Status ^ 1);

		GPIO_Set_Pin(GPIO_PortC, GPIO_P13, ~Status);

		/*		//Turn on the LED connected top Pin C13
		 GPIO_Set_Pin(GPIO_PortC, GPIO_P13, 0);

		 //wait for 500ms (0.5 seconds)
		 HAL_Delay(500);

		 //Turn off the LED
		 GPIO_Set_Pin(GPIO_PortC, GPIO_P13, 1);

		 //wait for 500ms (0.5 seconds)
		 HAL_Delay(500);*/
	}
	/* USER CODE END 3 */
}

void SystemClock_Config(void) {
	RCC_OscInitTypeDef RCC_OscInitStruct = { 0 };
	RCC_ClkInitTypeDef RCC_ClkInitStruct = { 0 };

	/** Initializes the RCC Oscillators according to the specified parameters
	 * in the RCC_OscInitTypeDef structure.
	 */
	RCC_OscInitStruct.OscillatorType = RCC_OSCILLATORTYPE_HSE;
	RCC_OscInitStruct.HSEState = RCC_HSE_ON;
	RCC_OscInitStruct.HSEPredivValue = RCC_HSE_PREDIV_DIV1;
	RCC_OscInitStruct.HSIState = RCC_HSI_ON;
	RCC_OscInitStruct.PLL.PLLState = RCC_PLL_ON;
	RCC_OscInitStruct.PLL.PLLSource = RCC_PLLSOURCE_HSE;
	RCC_OscInitStruct.PLL.PLLMUL = RCC_PLL_MUL9;
	if (HAL_RCC_OscConfig(&RCC_OscInitStruct) != HAL_OK) {
		Error_Handler();
	}

	/** Initializes the CPU, AHB and APB buses clocks
	 */
	RCC_ClkInitStruct.ClockType = RCC_CLOCKTYPE_HCLK | RCC_CLOCKTYPE_SYSCLK
			| RCC_CLOCKTYPE_PCLK1 | RCC_CLOCKTYPE_PCLK2;
	RCC_ClkInitStruct.SYSCLKSource = RCC_SYSCLKSOURCE_PLLCLK;
	RCC_ClkInitStruct.AHBCLKDivider = RCC_SYSCLK_DIV1;
	RCC_ClkInitStruct.APB1CLKDivider = RCC_HCLK_DIV2;
	RCC_ClkInitStruct.APB2CLKDivider = RCC_HCLK_DIV1;

	if (HAL_RCC_ClockConfig(&RCC_ClkInitStruct, FLASH_LATENCY_2) != HAL_OK) {
		Error_Handler();
	}
}

static void MX_GPIO_Init(void) {

	/* GPIO Ports Clock Enable */
	__HAL_RCC_GPIOD_CLK_ENABLE();
	__HAL_RCC_GPIOA_CLK_ENABLE();

}

void Error_Handler(void) {
	__disable_irq();
	while (1) {
	}
}
